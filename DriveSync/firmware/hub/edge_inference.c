/**
 * DriveSync Edge Inference — tflite-micro on ESP32-S3
 *
 * Eye-closure CNN + head-pose regression CNN.
 * Models quantized INT8, ~2 KB and ~8 KB respectively.
 *
 * License: MIT
 */

#include "edge_inference.h"
#include "esp_log.h"
#include <string.h>
#include <math.h>

static const char *TAG = "drivesync_edge";

/* ── TFLite Micro model data (embedded in flash) ─────────────────── */
/* In production, these are generated by train_drowsiness_cnn.py and */
/* train_headpose_cnn.py, then converted with TFLite converter.     */

/* Eye-closure CNN model (INT8 quantized, ~2 KB) */
__attribute__((aligned(16)))
static const unsigned char eye_closure_model_data[] = {
    /* Model placeholder — production binary embedded here */
    0x1c, 0x00, 0x00, 0x00, 0x54, 0x46, 0x4c, 0x33,  /* TFL3 header */
    /* ... model weights ... */
    0x00, /* sentinel */
};

/* Head-pose CNN model (INT8 quantized, ~8 KB) */
__attribute__((aligned(16)))
static const unsigned char headpose_model_data[] = {
    0x1c, 0x00, 0x00, 0x00, 0x54, 0x46, 0x4c, 0x33,
    /* ... model weights ... */
    0x00,
};

/* ── PERCLOS Rolling Window ───────────────────────────────────────── */

#define PERCLOS_WINDOW_SEC   60
#define FRAME_RATE_HZ        10
#define WINDOW_FRAMES        (PERCLOS_WINDOW_SEC * FRAME_RATE_HZ)  /* 600 */

static bool eye_closed_history[WINDOW_FRAMES];
static uint16_t history_idx = 0;
static bool history_full = false;

/* Blink detection */
#define BLINK_DEBOUNCE_FRAMES  3  /* min frames between blinks */
static uint16_t blink_count_1min = 0;
static uint32_t last_blink_frame = 0;
static uint32_t frame_counter = 0;
static bool eye_was_open = true;
static uint16_t blink_duration_frames = 0;

/* Head-bob detection */
#define HEAD_BOB_PITCH_THRESHOLD  1500  /* 15.00 degrees (centi) */
#define HEAD_BOB_VELOCITY_THRESHOLD 500  /* 5.00 deg/s */
static uint8_t head_bob_count = 0;
static int32_t head_pitch_history[30];  /* 3 sec at 10 Hz */
static uint16_t pitch_history_idx = 0;

/* ── Initialization ──────────────────────────────────────────────── */

void edge_inference_init(void)
{
    memset(eye_closed_history, 0, sizeof(eye_closed_history));
    history_idx = 0;
    history_full = false;
    blink_count_1min = 0;
    frame_counter = 0;
    head_bob_count = 0;
    memset(head_pitch_history, 0, sizeof(head_pitch_history));
    pitch_history_idx = 0;

    ESP_LOGI(TAG, "Edge inference initialized");
    ESP_LOGI(TAG, "  Eye-closure model: %d bytes", (int)sizeof(eye_closure_model_data));
    ESP_LOGI(TAG, "  Head-pose model: %d bytes", (int)sizeof(headpose_model_data));
}

/* ── Eye-Closure CNN (simplified inference) ─────────────────────── */

/**
 * Run the eye-closure CNN on an eye-region crop.
 * In production: TfLiteMicro::MicroInterpreter::Invoke()
 *
 * @return true if eyes are closed (>50% probability)
 */
static bool classify_eye_state(const uint8_t *eye_region, uint16_t w, uint16_t h)
{
    /*
     * Simplified heuristic (production uses INT8 CNN):
     * Compute mean pixel intensity in eye region.
     * Closed eyes have different texture (eyelid vs iris/sclera).
     * This stub uses pixel variance as a proxy.
     */
    if (eye_region == NULL || w == 0 || h == 0) return false;

    uint32_t sum = 0;
    uint32_t sq_sum = 0;
    uint32_t n = w * h;

    for (uint32_t i = 0; i < n && i < 4096; i++) {
        sum += eye_region[i];
        sq_sum += (uint32_t)eye_region[i] * eye_region[i];
    }

    float mean = (float)sum / n;
    float variance = ((float)sq_sum / n) - (mean * mean);

    /* Low variance → smooth eyelid → likely closed */
    /* High variance → iris/sclera texture → likely open */
    /* Threshold tuned empirically */
    return variance < 50.0f;

    /* Production version:
     * TfLiteTensor* input = interpreter->input(0);
     * Copy eye_region (48x48x1) into input tensor
     * interpreter->Invoke();
     * TfLiteTensor* output = interpreter->output(0);
     * float eye_open_prob = output->data.f[0];
     * return eye_open_prob < 0.5f;
     */
}

/* ── Head-Pose CNN (simplified inference) ────────────────────────── */

static void estimate_head_pose(const uint8_t *face_region, uint16_t w, uint16_t h,
                                int16_t *pitch, int16_t *yaw, int16_t *roll)
{
    /*
     * Simplified: center-of-mass offset as head-pose proxy.
     * Production: INT8 CNN regression (3 outputs: pitch, yaw, roll).
     */
    if (face_region == NULL || w == 0 || h == 0) {
        *pitch = *yaw = *roll = 0;
        return;
    }

    float cx = 0, cy = 0;
    uint32_t total_weight = 0;

    for (uint16_t y = 0; y < h; y += 4) {
        for (uint16_t x = 0; x < w; x += 4) {
            uint8_t px = face_region[y * w + x];
            if (px > 60) {  /* above noise floor */
                cx += x * px;
                cy += y * px;
                total_weight += px;
            }
        }
    }

    if (total_weight == 0) {
        *pitch = *yaw = *roll = 0;
        return;
    }

    cx /= total_weight;
    cy /= total_weight;

    /* Offset from center → head-pose proxy (centi-degrees) */
    float dx = (cx - w / 2.0f) / (w / 2.0f);  /* -1 to 1 */
    float dy = (cy - h / 2.0f) / (h / 2.0f);

    *yaw = (int16_t)(dx * 4500);   /* ±45° */
    *pitch = (int16_t)(dy * 3000);  /* ±30° */
    *roll = 0;  /* Roll requires more sophisticated analysis */
}

/* ── PERCLOS Computation ─────────────────────────────────────────── */

static float compute_perclos(void)
{
    uint16_t closed_count = 0;
    uint16_t count = history_full ? WINDOW_FRAMES : history_idx;

    for (uint16_t i = 0; i < count; i++) {
        if (eye_closed_history[i]) closed_count++;
    }

    if (count == 0) return 0.0f;
    return (float)closed_count / count;
}

/* ── Head-Bob Detection ───────────────────────────────────────────── */

static void update_head_bob(int16_t pitch)
{
    head_pitch_history[pitch_history_idx] = pitch;
    pitch_history_idx = (pitch_history_idx + 1) % 30;

    /* Detect head-bob: rapid pitch change (nodding) */
    if (pitch_history_idx >= 2) {
        int16_t prev = head_pitch_history[(pitch_history_idx + 28) % 30];
        int16_t curr = head_pitch_history[(pitch_history_idx + 29) % 30];
        int16_t delta = curr - prev;

        if (abs(delta) > HEAD_BOB_PITCH_THRESHOLD && curr > HEAD_BOB_PITCH_THRESHOLD) {
            head_bob_count++;
        }
    }

    /* Reset count every minute */
    if (frame_counter % (FRAME_RATE_HZ * 60) == 0 && frame_counter > 0) {
        head_bob_count = 0;
    }
}

/* ── Main Frame Processing ────────────────────────────────────────── */

bool edge_inference_process_frame(const uint8_t *frame_data,
                                   uint16_t width, uint16_t height,
                                   float *out_perclos,
                                   uint16_t *out_blink_rate,
                                   int16_t *out_head_pitch,
                                   int16_t *out_head_yaw,
                                   int16_t *out_head_roll,
                                   uint8_t *out_confidence)
{
    if (frame_data == NULL || width == 0 || height == 0) return false;

    /* Crop eye region (upper-center of frame, driver-facing) */
    uint16_t eye_x = width / 4;
    uint16_t eye_y = height / 4;
    uint16_t eye_w = width / 2;
    uint16_t eye_h = height / 6;

    /* Extract eye region (simplified — no face detection in stub) */
    const uint8_t *eye_region = frame_data + eye_y * width + eye_x;

    /* Classify eye state */
    bool eyes_closed = classify_eye_state(eye_region, eye_w, eye_h);

    /* Update PERCLOS history */
    eye_closed_history[history_idx] = eyes_closed;
    history_idx = (history_idx + 1) % WINDOW_FRAMES;
    if (history_idx == 0) history_full = true;

    /* Blink detection (rising edge: open → closed → open) */
    frame_counter++;
    if (eyes_closed) {
        blink_duration_frames++;
    } else if (eye_was_open == false && blink_duration_frames >= 1) {
        /* Blink completed */
        if (frame_counter - last_blink_frame > BLINK_DEBOUNCE_FRAMES) {
            blink_count_1min++;
            last_blink_frame = frame_counter;
        }
        blink_duration_frames = 0;
    }
    eye_was_open = !eyes_closed;

    /* Reset blink count every minute */
    if (frame_counter % (FRAME_RATE_HZ * 60) == 0 && frame_counter > 0) {
        blink_count_1min = 0;
    }

    /* Head-pose estimation */
    int16_t pitch, yaw, roll;
    const uint8_t *face_region = frame_data;
    estimate_head_pose(face_region, width, height, &pitch, &yaw, &roll);
    update_head_bob(pitch);

    /* Output features */
    if (out_perclos) *out_perclos = compute_perclos();
    if (out_blink_rate) *out_blink_rate = blink_count_1min;
    if (out_head_pitch) *out_head_pitch = pitch;
    if (out_head_yaw) *out_head_yaw = yaw;
    if (out_head_roll) *out_head_roll = roll;
    if (out_confidence) *out_confidence = 80;  /* Stub confidence */

    return true;
}

float edge_inference_get_perclos(void)
{
    return compute_perclos();
}

uint16_t edge_inference_get_blink_rate(void)
{
    return blink_count_1min;
}

uint8_t edge_inference_get_head_bob_count(void)
{
    return head_bob_count;
}